## boards/shields/corne_hw_right/Kconfig.defconfig
```kconfig
config ZMK_SPLIT
	def_bool y

config ZMK_SPLIT_BLE
	def_bool y

config ZMK_SPLIT_ROLE_PERIPHERAL
	def_bool y

config ZMK_USB
	def_bool y
```

## config/boards/shields/corne_hw_left/Kconfig.defconfig
```kconfig
config ZMK_SPLIT
	def_bool y

config ZMK_SPLIT_BLE
	def_bool y

config ZMK_SPLIT_ROLE_CENTRAL
	def_bool y

config ZMK_USB
	def_bool y
```

## config/boards/shields/corne_hw_right/Kconfig.shield
```kconfig
config SHIELD_CORNE_HW_RIGHT
    def_bool $(shields_list_contains,corne_hw_right)
```
