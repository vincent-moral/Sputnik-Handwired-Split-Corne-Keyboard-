## boards/shields/corne_hw/Kconfig.shield
```kconfig
config SHIELD_CORNE_HW_LEFT
    def_bool $(shields_list_contains,corne_hw_left)

config SHIELD_CORNE_HW_RIGHT
    def_bool $(shields_list_contains,corne_hw_right)
```
